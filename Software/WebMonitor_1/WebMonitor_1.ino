/*
 * Kommunikation zu TR-064 kompatiblem Router
 * 
 * Autor: Jörg Bernhardt
 * Datum: 11/2020
 * Board: LoLin ESP8266 D1 Mini
 * 
 * Änderungen by zeroTM
 * Datum: 06/2024
 * 
 *  Änderungen
 *  -- Adafruit ILI9341 
 *  ++ TFT_eSPI Bibliothek (mehrere Displays unterstützt!)
 *  -- ILI9341_Graphic.h (class komplett entfernt)
 *  -- ILI9341_Graphic.cpp (void-Funktionen in WebMonitor_1.ino eingefügt)
 *  
 *  in planung:
 *  ## auf Platformio wechseln
 *  ## ESP32 unterstützung
 *  ## Konfiguration erweitern(Einstellungen editierbar machen, Einstellungen erweitern)
 *  ## Touchscreen unterstützung
 *  ## Router Statistik 
 *  ## Call-Monitor
 * 
 * 
 * Arduino Settings:
 *    Board:  "LOLIN(WEMOS) D1 R2 & Mini"
 *    Upload Speed: "921600"
 *    CPU Frequency: "80MHz"
 *    Flash Size: "4MB (FS:2MB OTA:~1019KB)"
 *    Debug Port: "Disabled"
 *    Debug Level: keine"
 *    
 * 
 * wichtige Links:
 * https://github.com/Bodmer/TFT_eSPI
 * https://github.com/adafruit/Adafruit-GFX-Library
 * https://github.com/dancol90/ESP8266Ping
 * https://github.com/marian-craciunescu/ESP32Ping
 * https://github.com/Aypac/Arduino-TR-064-SOAP-Library
 * 
 */
#define FirmwareName "Web_Monitor"
#define HostName "WebMonitor"
#define FirmwareVersion "1.3+z1"

#if defined(ESP8266)
  #include <ESP8266WiFi.h>
  #include <ESP8266WiFiMulti.h>
  #include <ESP8266HTTPClient.h>
  ESP8266WiFiMulti WiFiMulti;
#elif defined(ESP32)
  #include <WiFi.h>
  #include <WiFiMulti.h>
  #include <HTTPClient.h>
  WiFiMulti WiFiMulti;
#endif

#include <Arduino.h>
#include <ArduinoOTA.h>
#include <Ticker.h>
#include <TFT_eSPI.h>        // Hardware-specific library

TFT_eSPI Display = TFT_eSPI();   // Invoke library


#include "ESP_Settings.h"
#include "TR064_Query.h"
#include "FastLED.h"                                     

// TFT-Einstellungen in der Datei "User_Setup.h" einstellen (im Ordner der TFT-eSPI Bibliothek)
//#define TFT_CS      15    // TFT CS  Pin ist verbunden mit NodeMCU Pin D8
//#define TFT_RST     16    // TFT RST Pin ist verbunden mit NodeMCU Pin D0
//#define TFT_DC      5     // TFT DC  Pin ist verbunden mit NodeMCU Pin D1
#define INDICATOR_LED_GREEN 0 // cut connection from T_CS and T_IRQ (touchscreen is not used!) and use it for network status leds (NodeMCU Pin D3)
#define INDICATOR_LED_RED 16// cut connection from T_CS and T_IRQ (touchscreen is not used!) and use it for network status leds (NodeMCU Pin D0) 
#define NEOPIXEL_PIN 4// cut connection from SD_CS (cardreader is not used!) and use it for a ws2812 rgbled-strip (NodeMCU Pin D2) 
#define COLOR_ORDER GRB                                       
#define LED_TYPE WS2812                                       
#define NUM_LEDS 8
uint8_t max_bright = 50;                         
struct CRGB leds[NUM_LEDS]; 

#define LED_RED     1     // Rote LED ist verbunden mit NodeMCU Pin TX
#define LED_GREEN   3     // Grüne LED ist verbunden mit NodeMCU Pin RX
#define SWITCH_01   2     // Taster S1 ist verbunden mit NodeMCU Pin D4
#define SWITCH_02   A0    // Taster S2 ist verbunden mit NodeMCU Pin A0

#define TFT_DARKORANGE 0xCB05

String GreenLEDMode = "off"; // off=start, blink=no internet/reconnect internet, on=internet connection
String RedLEDMode = "blink"; // off=start, blink=no internet/reconnect internet, on=internet connection
String BlinkMode = "normal";

ESP_Settings MyESP;                                                       // "MyESP" = neue Instanz der Klasse "ESP_Settings"
TR064_Query TR_064 = TR064_Query(49000, "192.168.178.254", "admin", "");  // "TR_064" = neue Instanz der Klasse "TR064_Query"
Ticker TickTimer;
Ticker blinkerGreen;
Ticker blinkerRed;
Ticker blinkerTest;
Ticker StatusTest;
Ticker NEOPIXEL_Ticker;

const char DEVICE_NAME[] = "ESP8266_TR064";
int iPosX = 10;
int iPosY = 20;
int iCurrentMode = 0;
int iTickerCount = 0;
int iOldTickerCount = 0;
int iDummy = 0;
long lDummy = 0;
long lUpNow = 0;
long lUpMax = 0;
long lDownNow = 0;
long lDownMax = 0;
long lStartTime = 0;
String sConnType = "";
String sRouterIP = "";
String sDnsIP = "";
IPAddress ipRouter;
IPAddress ipDNS;
String sESP8266IP = "";
IPAddress ipESP8266;
bool bNetworkAvailable;
bool bWifiAvailable;
bool bGuestActive;
bool bWebAvailable;
int iWhileCounter;
long lWifiSignal;
String sConnection;

unsigned long currentMillis_1;
unsigned long currentMillis_2;
        
enum PrgState {
  NORMAL,
  CONFIG,
  DEMO,
  GRAPHIC,
  TEXT
};

enum PrgState ProgState = NORMAL;

void TickerCounter(void);
//void DrawStartScreen(long lUpMaxValue, long lDownMaxValue);
//long S1_msTime(void);
//long S2_msTime(void);

void changeStateGreen(void)
{
  if(GreenLEDMode == "blink") {
  digitalWrite(INDICATOR_LED_GREEN, !(digitalRead(INDICATOR_LED_GREEN)));  //Invert Current State of LED  
  }
  if(GreenLEDMode == "off") {
  digitalWrite(INDICATOR_LED_GREEN, LOW); 
  }
  if(GreenLEDMode == "on") {
  digitalWrite(INDICATOR_LED_GREEN, HIGH); 
  }
}
void changeStateRed(void)
{
  if(RedLEDMode == "blink") {
  digitalWrite(INDICATOR_LED_RED, !(digitalRead(INDICATOR_LED_RED)));  //Invert Current State of LED  
  }
  if(RedLEDMode == "off") {
  digitalWrite(INDICATOR_LED_RED, LOW); 
  }
  if(RedLEDMode == "on") {
  digitalWrite(INDICATOR_LED_RED, HIGH); 
  }
}
void testBlinkPoints(void) {
  if(BlinkMode == "test"){
  Serial.print("."); 
  Display.print("."); 
  }
}
void LedTicker(void) {
    uint8_t thisSpeed = 30;
    uint8_t deltaHue= 10;
    uint8_t thisHue = beat8(thisSpeed,255); 
    fill_rainbow(leds, NUM_LEDS, thisHue, deltaHue);            
    FastLED.show();
}

void setup(){
  ESP.wdtDisable();             // Disable ESP8266 Software Watchdog
    
  String sWifiSSID = MyESP.Read_WifiSSID();
  String sWifiPassword = MyESP.Read_WifiPassword();
  String sTR064_User = MyESP.Read_TR064_User();
  String sTR064_Password = MyESP.Read_TR064_Password();
  unsigned long ulMaxDL_Speed = MyESP.Read_Download_Speed();
  String sMaxDL_Speed = String(ulMaxDL_Speed);
  unsigned long ulMaxUL_Speed = MyESP.Read_Upload_Speed();
  String sMaxUL_Speed = String(ulMaxUL_Speed);
            GreenLEDMode = "off";
            RedLEDMode = "off";
  
  Serial.begin(115200);
  LEDS.addLeds<LED_TYPE, NEOPIXEL_PIN, COLOR_ORDER>(leds, NUM_LEDS);      
   FastLED.setBrightness(max_bright);         

  pinMode(INDICATOR_LED_GREEN, OUTPUT);
  pinMode(INDICATOR_LED_RED, OUTPUT);
  digitalWrite(INDICATOR_LED_GREEN, LOW); 
  digitalWrite(INDICATOR_LED_RED, LOW); 
  Display.begin();               // Initialise the display
  Display.setRotation(1);
  Display.fillScreen(TFT_BLACK); // Black screen fill
  Display.invertDisplay( true );
    Display.fillScreen(TFT_BLACK);
    DrawLogo(190,10);
    Display.setTextSize(1);
    Display.setCursor(207, 100);
    Display.setTextColor(TFT_CYAN);
    Display.print("FW v."); Display.print(FirmwareVersion);
    Serial.print("FW v.");
    Serial.println(FirmwareVersion);
    Display.setTextColor(TFT_WHITE);
    Display.setCursor(10, 25);
    Display.println("** Programm Init **");
    iPosY = iPosY + 25; Display.setCursor(iPosX, iPosY);
    Display.println("LedTest: blink 5s");
      iPosY = iPosY + 15; Display.setCursor(iPosX, iPosY);

        
   
    Serial.println("");
    Serial.println("");
    Serial.println("**************");
    Serial.println("Programm Init");
    Serial.println("**************");
    //Serial.println("Init Ticker");
  //Initialize Ticker every 0.5s
  blinkerGreen.attach(0.5, changeStateGreen); //Use attach_ms if you need 
  blinkerRed.attach(0.1, changeStateRed); //Use attach_ms if you need 
  blinkerTest.attach(1.0, testBlinkPoints); //Use attach_ms if you need 
  //StatusTest.attach(60.0, showMyStatus); //Use attach_ms if you need 
  NEOPIXEL_Ticker.attach(0.1, LedTicker); //Use attach_ms if you need 
    

//ledtest
    Serial.println("LedTest: blink 5s");
            Serial.print(".");  
            BlinkMode = "test";
            GreenLEDMode = "blink";
            RedLEDMode = "blink";
            delay(5000);
    Serial.println("");
    Serial.println("LedTest ende.");
        iPosY = iPosY + 25; Display.setCursor(iPosX, iPosY);
        Display.println("LedTest ende.");
            BlinkMode = "normal";
            GreenLEDMode = "off";
            RedLEDMode = "off";
  

  pinMode(SWITCH_01, INPUT);
  //pinMode(LED_RED, OUTPUT);
  //pinMode(LED_GREEN, INPUT);
  //digitalWrite(LED_RED, LOW); 
  //digitalWrite(LED_GREEN, LOW); 
    Display.setTextColor(TFT_YELLOW);
    iPosY = iPosY + 25; Display.setCursor(iPosX, iPosY);
    Display.print("Konfiguration starten ");
    Serial.println("Konfiguration starten");
    for (int i=10; i>0; i--){
      Display.print(".");
      if(i == 10){ Serial.println("[          ]");}
      if(i == 9){  Serial.println("[.         ]");}
      if(i == 8){  Serial.println("[..        ]");}
      if(i == 7){  Serial.println("[...       ]");}
      if(i == 6){  Serial.println("[....      ]");}
      if(i == 5){  Serial.println("[.....     ]");}
      if(i == 4){  Serial.println("[......    ]");}
      if(i == 3){  Serial.println("[.......   ]");}
      if(i == 2){  Serial.println("[........  ]");}
      if(i == 1){  Serial.println("[......... ]");}
      if(i == 0){  Serial.println("[..........]");}
      delay(500);
      ESP.wdtFeed();
    }
    Serial.println("");
iPosX = 10;
iPosY = 20;



  
  ProgState = NORMAL;
  if((analogRead(SWITCH_02) < 512) || (digitalRead(SWITCH_01) == LOW)){
    ProgState = DEMO;
    Serial.print("ProgState: ");
    Serial.println("DEMO");
    ArduinoOTA.begin();
  }

  if(ProgState == NORMAL){
    Serial.print("ProgState: ");
    Serial.println("NORMAL");
    Display.fillScreen(TFT_BLACK);
    DrawLogo(190,10);
    Display.setTextSize(1);
    Display.setCursor(207, 100);
    Display.setTextColor(TFT_CYAN);
    Display.print("FW v."); Display.print(FirmwareVersion);
    Serial.print("FW v.");
    Serial.println(FirmwareVersion);
    Display.setTextColor(TFT_WHITE);
    Display.setCursor(10, 25);
    Display.println("** Konfiguration **");
    Serial.println("** Konfiguration ** ");
    iPosY = iPosY + 25; Display.setCursor(iPosX, iPosY);
    sWifiSSID.trim();
    if(sWifiSSID == ""){                                // Sind Netzwerkeinstellungen im EEPROM gespeichert?    
      WiFi.disconnect();
      WiFi.mode(WIFI_AP);
      WiFi.softAPConfig(IPAddress(192, 168, 4, 1), IPAddress(192, 168, 4, 1), IPAddress(255, 255, 255, 0));
      WiFi.softAP(HostName);                  // SSID = "Web_Monitor" [kein Passwort]
      delay(500);
      DrawMessageScreen_01("192.168.4.1");
      bool bShowMsgScr = true;
      while(1){
        MyESP.WebInterface(true);   // Website mit Konfigurationsmöglichkeiten anzeigen
        delay(5);
        sWifiSSID = MyESP.Read_WifiSSID(); sWifiSSID.trim();
        if(sWifiSSID.length() > 3){
          sWifiPassword = MyESP.Read_WifiPassword(); sWifiPassword.trim();
          sTR064_User = MyESP.Read_TR064_User(); sTR064_User.trim();
          sTR064_Password = MyESP.Read_TR064_Password(); sTR064_Password.trim();
          ulMaxDL_Speed = MyESP.Read_Download_Speed(); sMaxDL_Speed = String(ulMaxDL_Speed / 1000);
          ulMaxUL_Speed = MyESP.Read_Upload_Speed(); sMaxUL_Speed = String(ulMaxUL_Speed / 1000);
          if(bShowMsgScr == true) DrawMessageScreen_02(sWifiSSID,sWifiPassword, sTR064_User, sTR064_Password, sMaxDL_Speed, sMaxUL_Speed);
          bShowMsgScr = false;
        }
        if((analogRead(SWITCH_02) < 512) || (digitalRead(SWITCH_01) == LOW)) ESP.restart();
      }
    }
    else{
      sWifiSSID = MyESP.Read_WifiSSID(); sWifiSSID.trim();
      sWifiPassword = MyESP.Read_WifiPassword(); sWifiPassword.trim();
      Display.println(sWifiSSID + " verbinden:");
      Serial.println(sWifiSSID + " verbinden:");
            GreenLEDMode = "blink";
      iPosY = iPosY + 15; Display.setCursor(iPosX, iPosY);
      WiFi.hostname(HostName);
      WiFi.mode(WIFI_STA);
      iDummy = 0;
      WiFi.begin(sWifiSSID, sWifiPassword);
      while ((WiFi.status() != WL_CONNECTED)){
        Display.print(".");
        Serial.print(".");
        ++iDummy;
        delay(400 + 100 * iDummy);

        if(digitalRead(SWITCH_01) == LOW){
          DrawMessageScreen_03();
          lStartTime = millis();
          while(1){
            if ((millis() - lStartTime) > 8000){
              MyESP.DeleteEEPROM();
              DrawMessageScreen_04();
              delay(5000);
              ESP.restart(); 
              delay(500);
            }
            if(digitalRead(SWITCH_01) == HIGH) ESP.restart();
            delay(500);
          }
        }
        
        if(iDummy > 25) break;
        ESP.wdtFeed();
      }


      if(iDummy <= 25){
        iPosY = iPosY + 25; Display.setCursor(iPosX, iPosY);
        Display.println("WLAN-Verbindung hergestellt.");
        Serial.println("WLAN-Verbindung hergestellt.");
        delay(500);
        ipDNS = WiFi.dnsIP();
        //ipRouter = {192,168,188,1};
        ipRouter = WiFi.gatewayIP();
        sRouterIP = String(ipRouter[0]) + "." + String(ipRouter[1]) + "." + String(ipRouter[2]) + "." + String(ipRouter[3]);
        sDnsIP = String(ipDNS[0]) + "." + String(ipDNS[1]) + "." + String(ipDNS[2]) + "." + String(ipDNS[3]);
        iPosY = iPosY + 20; Display.setCursor(iPosX, iPosY);
        Display.println("Router IP: " + sRouterIP);
        Serial.println("Router IP: " + sRouterIP);
        iPosY = iPosY + 20; Display.setCursor(iPosX, iPosY);
        Display.println("DNS IP: " + sDnsIP);
        Serial.println("DNS IP: " + sDnsIP);
        ipESP8266 = WiFi.localIP();
        sESP8266IP = String(ipESP8266[0]) + "." + String(ipESP8266[1]) + "." + String(ipESP8266[2]) + "." + String(ipESP8266[3]);
        iPosY = iPosY + 20; Display.setCursor(iPosX, iPosY);
        Display.println("Eigene IP: " + sESP8266IP);
        Serial.println("Eigene IP: " + sESP8266IP);
        iPosY = iPosY + 20; Display.setCursor(iPosX, iPosY);
        sTR064_User = MyESP.Read_TR064_User(); sTR064_User.trim();
         String sESP8266Settings = String(sTR064_User) + "/" + String(sTR064_Password);
        Serial.println("TR064_test: " + sESP8266Settings);
        TR_064.~TR064_Query();                                                      // Default-Instanz "TR_064" mittels Destructor löschen
            RedLEDMode = "blink";
        new(&TR_064) TR064_Query(49000, sRouterIP, sTR064_User, sTR064_Password);   // Neue Instanz "TR_064" mit aktuellen Parametern erzeugen
        TR_064.init();
        iDummy = TR_064.getDeviceNumber();
        if(iDummy != 0){
          Display.println("TR-064 Verbindung hergestellt.");
          ProgState = NORMAL;  
        }
        else{
          Display.println("TR-064 Verbindung gescheitert.");
          ProgState = CONFIG;  
        }
            RedLEDMode = "off";
      }
      else ProgState = CONFIG;
        
      if(ProgState == CONFIG){
        Serial.print("ProgStare: ");
        Serial.println("CONFIG");
        Display.setTextColor(TFT_YELLOW);
        iPosY = 175; Display.setCursor(iPosX, iPosY);
        Display.println("Taster S1 kurz dr\201cken, um neu zu starten.");
        Serial.println("Taster S1 kurz dr\201cken, um neu zu starten.");
        iPosY = iPosY + 15; Display.setCursor(iPosX, iPosY);
        Display.println("Taster S1 >5s dr\201cken, um die existierende");
        Serial.println("Taster S1 >5s dr\201cken, um die existierende");
        iPosY = iPosY + 15; Display.setCursor(iPosX, iPosY);
        Display.println("Konfiguration zu l\224schen und neu einzugeben.");
        Serial.println("Konfiguration zu l\224schen und neu einzugeben.");
        iPosY = iPosY + 15; Display.setCursor(iPosX, iPosY);
        Display.println("Taster S2 kurz dr\201cken, um Demo-Modus zu starten.");   
        Serial.println("Taster S2 kurz dr\201cken, um Demo-Modus zu starten.");
        while(1){
          ESP.wdtFeed();
          delay(10);
          long lTimeS1 = S1_msTime();
          if(lTimeS1 > 50){
            if(lTimeS1 > 5000) MyESP.DeleteEEPROM();
            ESP.restart();        
          }
          long lTimeS2 = S2_msTime();
          if(lTimeS2 > 50){
            ProgState = DEMO;
            break;
          }
        }
      }
    }

    sConnType = TR_064.getDefaultConnectionService();
    if(sConnType.indexOf("WANPPP") != -1) sConnType = "WAN-PPP";
    else sConnType = "WAN-IP";
    iPosY = iPosY + 25; Display.setCursor(iPosX, iPosY);
    Display.println("Es existiert eine " + sConnType + " Internetverbindung.");
    Serial.println("Es existiert eine " + sConnType + " Internetverbindung.");
    Display.setTextColor(TFT_YELLOW);
    iPosY = iPosY + 25; Display.setCursor(iPosX, iPosY);
    Display.print("Programm starten ");
    Serial.println("Programm starten");
    for (int i=10; i>0; i--){
      Display.print(".");
      if(i == 10){ Serial.println("[          ]");}
      if(i == 9){  Serial.println("[.         ]");}
      if(i == 8){  Serial.println("[..        ]");}
      if(i == 7){  Serial.println("[...       ]");}
      if(i == 6){  Serial.println("[....      ]");}
      if(i == 5){  Serial.println("[.....     ]");}
      if(i == 4){  Serial.println("[......    ]");}
      if(i == 3){  Serial.println("[.......   ]");}
      if(i == 2){  Serial.println("[........  ]");}
      if(i == 1){  Serial.println("[......... ]");}
      if(i == 0){  Serial.println("[..........]");}
      delay(500);
      ESP.wdtFeed();
    }
    
    if(ulMaxUL_Speed<1000){
      lUpMax = long(TR_064.getUpstreamMaxBitRate());
    }
    else lUpMax = ulMaxUL_Speed;
    if(ulMaxDL_Speed<1000){
      lDownMax = long(TR_064.getDownstreamMaxBitRate());
    }
    else lDownMax = ulMaxDL_Speed;
  
    DrawStartScreen(lUpMax, lDownMax);
    bNetworkAvailable = true;
    bWebAvailable = true;
    bWifiAvailable = true;
    
    TickTimer.attach(0.8, TickerCounter);
  }
}

//###########################################################################################################

void loop(){

  ESP.wdtFeed();
  if(ProgState == DEMO) ShowDemo();
    
  if(iTickerCount != iOldTickerCount){
    iOldTickerCount = iTickerCount;
    MyESP.WebInterface(false);                                          // Website mit Konfigurationsmöglichkeiten anzeigen
    if(bWebAvailable == true){
      DrawConnection(155, 38, true);
    }
    else{
      DrawConnection(155, 38, false);
    }

    if((analogRead(SWITCH_02) < 512) || (digitalRead(SWITCH_01) == LOW)){
      DrawMessageScreen_03();
      lStartTime = millis();
      while(1){
        ESP.wdtFeed();
        if((analogRead(SWITCH_02) > 512) && (digitalRead(SWITCH_01) == HIGH)) break;
        if ((millis() - lStartTime) > 8000){
          MyESP.DeleteEEPROM();
          DrawMessageScreen_04();
          delay(5000);
          ESP.restart(); 
        }
      }
      Display.fillScreen(TFT_BLACK);
      DrawCloud(10, 85, TFT_CYAN);
      DrawComputer(10, 195, TFT_GREEN);
      DrawArrowUpTiny(20, 107, TFT_CYAN);
      DrawArrowDownTiny(20, 175, TFT_GREEN);
      DrawTextBits(40, 65, lUpMax, TFT_LIGHTGREY);
      DrawTextBits(40, 155, lDownMax, TFT_LIGHTGREY);
      iTickerCount = 1;
    }

    if(iTickerCount == 1){                                              // TickerCount 1: WLAN-Verbindung und Erreichbarkeit des Routers überprüfen und darstellen    
      iWhileCounter = 0;
      while(1){                                                         // so lange in der Schleife laufen bis der Router per TR-064 erreicbar ist
        if(iWhileCounter > 0) delay(200);
        if(iWhileCounter > 10000) iWhileCounter = 10000;
        ++iWhileCounter;
        bWifiAvailable = false;
        bNetworkAvailable = false;
        if(WiFi.status() == WL_CONNECTED){                              // prüfen ob das WLAN verbunden ist
          lWifiSignal =  WiFi.RSSI();
          bWifiAvailable = true;
          if(TR_064.getDeviceNumber() != 0) bNetworkAvailable = true;   // prüfen ob der Router per TR-064 erreicbar ist
        }
        if(iWhileCounter > 3){                                          // nach >3 Schleifenduchläufen Display Daktivierung darstellen
          if(bWifiAvailable == false){
            DrawWifi(12, 12, TFT_DARKGREY,"");                     // Wifi Signal auf grau stellen wenn kein WLAN erreichbar
          }
          else{
            DrawWifi(12, 12, TFT_WHITE, String(lWifiSignal));   // Wifi Signal anzeigen wenn WLAN erreichbar ist
          }
          DrawGuest(150, 7, TFT_BLACK, TFT_BLACK);          // Symbole auf Deaktiviert stellen ...
          DrawFlashTiny(75, 10, TFT_YELLOW);                    // ... Blitz Symbol zwischen Wifi-Signal und Router anzeigen ...
          DrawRouter(100, 12, false);
          DrawConnection(155, 35, false);
          DrawEarth(250, 10, false);
          if((iWhileCounter % 5) == 0){                                 // ... Bitraten in Grid-Arrays mit Wert 0 zyklisch vorschieben
            DrawGrid_01(80, 65, 0, lUpMax, TFT_CYAN);
            DrawTextBits(40, 65, lUpMax, TFT_LIGHTGREY);
            DrawTextBits(40, 80, 0, TFT_CYAN);
            DrawGrid_02(80, 155, 0, lDownMax, TFT_GREEN);
            DrawTextBits(40, 155, lDownMax, TFT_LIGHTGREY);
            DrawTextBits(40, 170, 0, TFT_GREEN);
          }
          iTickerCount = 0;                                             // iTickerCount auf 0 setzen für einen definierten Start nach neuem Kontakt zum Router
        }
        
        if(bNetworkAvailable == true){                                  // der Router konnte per TR-064 erreicht werden
          DrawFlashTiny(75, 10, TFT_BLACK);
          DrawWifi(12, 12, TFT_WHITE, String(lWifiSignal));
          DrawRouter(100, 12, true);
          if(bWebAvailable == true){
            DrawFlashTiny(210, 10, TFT_BLACK);
            DrawEarth(250, 10, true);
            GreenLEDMode = "on";
            Serial.print("Internet: Online ");
          }
          else{
            DrawFlashTiny(210, 10, TFT_YELLOW);
            DrawEarth(250, 10, false);
            GreenLEDMode = "blink";
            Serial.print("Internet: Offline.");
          }
          if(bGuestActive == true) DrawGuest(150, 7, TFT_ORANGE, TFT_DARKORANGE);
          else DrawGuest(150, 7, TFT_BLACK, TFT_BLACK); 
          break;                                                        // Router per TR-064 erreichbar --> Schleife verlassen
        }
      }      
    }

    if(iTickerCount == 2){                                              // TickerCount 2: aktuelle Upload- und Download-Geschwindigkeit abrufen
      RedLEDMode = "blink";
      lUpNow = long(TR_064.getNewByteUploadRate());
      lDownNow = long(TR_064.getNewByteDownloadRate()); 
    if(Serial) Serial.println("\n\rTR064: Current up/download speed: " + String(lUpNow) + "/" + String(lDownNow));
            RedLEDMode = "off";
    }

    if(iTickerCount == 3){                                              // TickerCount 3: Aktuelle Upload- und Download-Geschwindigkeit anzeigen
      DrawGrid_01(80, 65, lUpNow, lUpMax, TFT_CYAN);
      DrawTextBits(40, 65, lUpMax, TFT_LIGHTGREY);
      DrawTextBits(40, 80, lUpNow, TFT_CYAN);
      DrawGrid_02(80, 155, lDownNow, lDownMax, TFT_GREEN);
      DrawTextBits(40, 155, lDownMax, TFT_LIGHTGREY);
      DrawTextBits(40, 170, lDownNow, TFT_GREEN);
    }

    if(iTickerCount == 4){
      if(sConnType == "WAN-PPP") sConnection = TR_064.getWANPPPConnectionStatus();
      else if(sConnType == "WAN-IP") sConnection = TR_064.getWANIPConnectionStatus();
      else sConnection = "none";
      sConnection.toUpperCase();
      if(sConnection == "CONNECTED") bWebAvailable = true; else bWebAvailable = false;      
    }

    if(iTickerCount == 5){
      if(TR_064.getGuestWlanEnabled() == 0) bGuestActive = false; else bGuestActive = true;
    }
    
  }  
}


//###########################################################################################################

void TickerCounter(void){
  iTickerCount++;
  if(iTickerCount >= 7){
    iTickerCount = 0;
  }
}

void DrawStartScreen(long lUpMaxValue, long lDownMaxValue){
  Display.fillScreen(TFT_BLACK);
  DrawConnection(155, 35, false);
  DrawFlashTiny(75, 10, TFT_DARKGREY);
  DrawFlashTiny(210, 10, TFT_DARKGREY);
  DrawWifi(12, 12, TFT_DARKGREY, "");
  DrawCloud(10, 85, TFT_CYAN);
  DrawComputer(10, 195, TFT_GREEN);
  DrawArrowUpTiny(20, 107, TFT_CYAN);
  DrawArrowDownTiny(20, 175, TFT_GREEN);
  DrawRouter(100, 12, false);
  DrawGuest(150, 7, TFT_LIGHTGREY, TFT_DARKGREY);
  DrawEarth(250, 10, false);
  DrawTextBits(40, 65, lUpMaxValue, TFT_LIGHTGREY);
  DrawTextBits(40, 80, 0, TFT_CYAN);
  DrawGrid_01(80, 65, 0, lUpMax, TFT_CYAN);
  DrawTextBits(40, 155, lDownMaxValue, TFT_LIGHTGREY);
  DrawTextBits(40, 170, 0, TFT_GREEN);
  DrawGrid_02(80, 155, 0, lDownMax, TFT_GREEN);
}


long S1_msTime(void){
  static boolean bOldState = true;
  static unsigned long lStartMillis = 0;
  unsigned long lMillis;

  if(bOldState == true){
    if(digitalRead(SWITCH_01) == LOW){
      lStartMillis = millis();
      bOldState = false;
    }
  }
  else{
    if(digitalRead(SWITCH_01) == true){
      lMillis = millis();
      lMillis = lMillis - lStartMillis;
      bOldState = true;
      return long(lMillis);
    }
  }  
  return 0;
}
long S2_msTime(void){
  static boolean bOldState = true;
  static unsigned long lStartMillis = 0;
  unsigned long lMillis;

  if(bOldState == true){
    if(analogRead(SWITCH_02) < 512){
      lStartMillis = millis();
      bOldState = false;
    }
  }
  else{
    if(analogRead(SWITCH_02) > 512){
      lMillis = millis();
      lMillis = lMillis - lStartMillis;
      bOldState = true;
      return long(lMillis);
    }
  }  
  return 0;
}

void ShowDemo(void){
int iRndUpLoad;
int iRndDownLoad;
int iRndWifi;
int iLoopCounter;
int iCountNo2;
bool bError;

  pinMode(LED_BUILTIN, OUTPUT);
  digitalWrite(LED_BUILTIN, HIGH);
  digitalWrite(LED_RED, HIGH);
  DrawStartScreen(2000, 16000);
  Display.setTextColor(TFT_WHITE, TFT_RED);
  Display.setCursor(96, 53);
  Display.print("  DEMO MODUS & OTA Programming  ");
  delay(1000);
  DrawRouter(100, 12, true);
  DrawGuest(150, 7, TFT_BLACK, TFT_BLACK);
  DrawEarth(250, 10, true);
  DrawFlashTiny(75, 10, TFT_BLACK);
  DrawFlashTiny(210, 10, TFT_BLACK);
  iLoopCounter = 0;
  iCountNo2 = 0;
  bError = false;
  while(1){
    ESP.wdtFeed();
    delay(700);
    ArduinoOTA.handle();
    if(bError == false) DrawConnection(155, 38, true);
    if(iLoopCounter == 0){
      if(bError == false) iRndUpLoad = random(300, 1000); else iRndUpLoad = 0;
      DrawTextBits(40, 80, iRndUpLoad, TFT_CYAN);
      DrawGrid_01(80, 65, iRndUpLoad, 2000, TFT_CYAN);
      if(bError == false) iRndDownLoad = random(7000, 12000); else iRndDownLoad = 0;
      DrawTextBits(40, 170, iRndDownLoad, TFT_GREEN);
      DrawGrid_02(80, 155, iRndDownLoad, 16000, TFT_GREEN);
      iRndWifi = random(-64, -54);
      DrawWifi(12, 12, TFT_WHITE, String(iRndWifi));
      iCountNo2++;
      if(iCountNo2 == 10) DrawGuest(150, 7, TFT_ORANGE, TFT_DARKORANGE);
      if(iCountNo2 == 20) DrawGuest(150, 7, TFT_BLACK, TFT_BLACK);
      if(iCountNo2 == 25){
        DrawFlashTiny(210, 10, TFT_YELLOW);
        DrawConnection(155, 38, false);
        DrawEarth(250, 10, false);
        bError = true;
      }
      if(iCountNo2 == 30){
        DrawRouter(100, 12, false);
        DrawFlashTiny(75, 10, TFT_YELLOW);
        DrawFlashTiny(210, 10, TFT_BLACK);
        DrawConnection(155, 38, false);
        bError = true;
      }
      if(iCountNo2 == 37){
        DrawRouter(100, 12, true);
        DrawFlashTiny(75, 10, TFT_BLACK);
        DrawFlashTiny(210, 10, TFT_BLACK);
        DrawEarth(250, 10, true);
        bError = false;
        iCountNo2 = 0;
      }
    }
    iLoopCounter++;
    if(iLoopCounter == 8) iLoopCounter = 0;
    if((analogRead(SWITCH_02) < 512) || (digitalRead(SWITCH_01) == LOW)) ESP.restart();
  }
}


//////////


void DrawTextBits(int xPos, int yPos, long lValue, uint16_t u16Color)
{
  String sText;
  float  fValue;
  char   sBuf[6];
  
  lValue = abs(lValue);
  if(lValue > 999999){                                  // wenn Wert > 999 MBit/s
    fValue = (float)lValue / 1000000;
    if(fValue < 10) dtostrf(fValue, 4, 2, sBuf);        // 1 Vorkommazeichen + "Punkt" + 2 Nachkommazeichen + '\0' = 6 Array-Felder
    else if(fValue < 100) dtostrf(fValue, 3, 0, sBuf);  // 2 Vorkommazeichen + 0 Nachkommazeichen + '\0' = 5 Array-Felder
    else dtostrf(fValue, 3, 0, sBuf);                   // 3 Vorkommazeichen + 0 Nachkommazeichen + '\0' = 5 Array-Felder
    sBuf[5] = '\0';
    sText = String(sBuf);
    sText.replace(".", ",");
    sText.trim();
  }
  else if(lValue > 999){                          // wenn Wert > 999 kBit/s
    fValue = (float)lValue / 1000;
    if(fValue < 10) dtostrf(fValue, 4, 2, sBuf);        // 1 Vorkommazeichen + "Punkt" + 2 Nachkommazeichen + '\0' = 6 Array-Felder
    else if(fValue < 100) dtostrf(fValue, 3, 0, sBuf);  // 2 Vorkommazeichen + 0 Nachkommazeichen + '\0' = 5 Array-Felder
    else dtostrf(fValue, 3, 0, sBuf);                   // 3 Vorkommazeichen + 0 Nachkommazeichen + '\0' = 5 Array-Felder
    sBuf[5] = '\0';
    sText = String(sBuf);
    sText.replace(".", ",");
    sText.trim();
  }
  else sText = String(lValue);                          // wenn Wert < 1000 kBit/s
  
  while(sText.length() < 4) sText = " " + sText;        // Links mit Leerzeichen auffüllen zur rechtbündige Ausrichtung
  Display.setCursor(xPos, yPos);
  Display.setTextSize(1);
  Display.setTextColor(u16Color, TFT_BLACK);
  Display.println(sText);

  if(lValue > 999999) sText = "G";              // wenn Wert > 999999 = Gbit/s
  else if(lValue > 999) sText = "M";            // wenn Wert > 999 = Mbit/s
  else sText = "K";                             // wenn Wert < 1000 = Bit/s
  Display.setCursor(xPos+27, yPos);
  Display.println(sText);
}


/*  Der Farbwert besteht aus 5 Bit (0..31) für die Farben Rot und Blau sowie 6 Bit (0...63) füe die Farbe Grün.
* Zur Vereinfachung werden dieser Funktion jeweils gültige Farbwerte von 0...255 übergeben.
* Diese werden in den gültigen Wertebereich umgerechnet und in den 16-Bit Wert geschrieben: uint16_t (RRRRRGGGGGGBBBBB) 
*/
uint16_t getColorValue(byte bRed, byte bGreen, byte bBlue)
{
  uint16_t iRed;
  uint16_t iGreen;
  uint16_t iBlue;

  iRed = bRed & B11111000;
  iRed = iRed << 8;
  iGreen = bGreen & B11111000;
  iGreen = iGreen << 3;
  iBlue = bBlue & B11111000;
  iBlue = iBlue >> 3;
  return (iRed | iGreen | iBlue);
}


void DrawConnection(int xPos, int yPos, boolean bStatus)
{
  static boolean blnDirection = false;  
  static byte bPosition = 0;
  byte bOldPosition;
  uint16_t iColor;
  
  if(bStatus==false){
    Display.fillCircle(xPos + bPosition, yPos, 4, TFT_BLACK);
    Display.drawLine(xPos, yPos, xPos+80, yPos, TFT_BLACK);
  }
  if(bStatus==true){
    bOldPosition = bPosition;
    if(blnDirection == true){
      iColor = TFT_GREEN;
      bPosition = bPosition -5;
      if(bPosition < 7) blnDirection = false;
    }
    else {
      iColor = TFT_CYAN;
      bPosition = bPosition + 5;
      if(bPosition > 73) blnDirection = true;
    }
    Display.fillCircle(xPos + bOldPosition, yPos, 4, TFT_BLACK);
    Display.fillCircle(xPos + bPosition, yPos, 4, iColor);
    Display.drawLine(xPos, yPos, xPos+80, yPos, iColor);
  }
}


void DrawGrid_01(int xPos, int yPos, long currentValue, long maxValue, uint16_t barColor)
{
  static long arrayValue[226];
  static int iOldValue;  
  int iValue;
  int iBlack;
  int iStepwidth; 
  
  if(maxValue==0){
    iOldValue = 0;
    for(int i=0; i<226; i++){
      arrayValue[i] = 0;
    }
    return;
  }

  for(int i=220; i>0; i--)  arrayValue[i+5] = arrayValue[i];

  if(currentValue>maxValue) currentValue = maxValue;
  iValue = int(74 * currentValue / maxValue);

  iStepwidth = iOldValue - iValue;
  iStepwidth = int(iStepwidth / 4);
  arrayValue[1] = iValue;
  arrayValue[2] = iStepwidth + iValue;
  arrayValue[3] = (iStepwidth * 2) + iValue;
  arrayValue[4] = (iStepwidth * 3) + iValue;
  arrayValue[5] = iOldValue;

  iOldValue = iValue;

  Display.drawRect(xPos, yPos, 226, 76, TFT_WHITE);
  for(int i=1; i<225; i++){
    if(i%15==0) Display.drawFastVLine(xPos + i, yPos + 1, 74, TFT_DARKGREY);
    else{
      iValue = arrayValue[i];
      if(iValue<1) iValue = 1;
      iBlack = 74 - iValue;
      Display.drawFastVLine(xPos + i, yPos + 1 + iBlack, iValue, barColor);
      Display.drawFastVLine(xPos + i, yPos + 1, iBlack, TFT_BLACK);
      Display.drawPixel(xPos + i, yPos + 15, TFT_DARKGREY);
      Display.drawPixel(xPos + i, yPos + 30, TFT_DARKGREY);
      Display.drawPixel(xPos + i, yPos + 45, TFT_DARKGREY);
      Display.drawPixel(xPos + i, yPos + 60, TFT_DARKGREY);
    } 
  }
}

void DrawGrid_02(int xPos, int yPos, long currentValue, long maxValue, uint16_t barColor)
{
  static long arrayValue[226];
  static int iOldValue;  
  int iValue;
  int iBlack;
  int iStepwidth; 
  
  if(maxValue==0){
    iOldValue = 0;
    for(int i=0; i<226; i++){
      arrayValue[i] = 0;
    }
    return;
  }

  for(int i=220; i>0; i--)  arrayValue[i+5] = arrayValue[i];

  if(currentValue>maxValue) currentValue = maxValue;
  iValue = int(74 * currentValue / maxValue);

  iStepwidth = iOldValue - iValue;
  iStepwidth = int(iStepwidth / 4);
  arrayValue[1] = iValue;
  arrayValue[2] = iStepwidth + iValue;
  arrayValue[3] = (iStepwidth * 2) + iValue;
  arrayValue[4] = (iStepwidth * 3) + iValue;
  arrayValue[5] = iOldValue;

  iOldValue = iValue;

  Display.drawRect(xPos, yPos, 226, 76, TFT_WHITE);
  for(int i=1; i<225; i++){
    if(i%15==0) Display.drawFastVLine(xPos + i, yPos + 1, 74, TFT_DARKGREY);
    else{
      iValue = arrayValue[i];
      if(iValue<1) iValue = 1;
      iBlack = 74 - iValue;
      Display.drawFastVLine(xPos + i, yPos + 1 + iBlack, iValue, barColor);
      Display.drawFastVLine(xPos + i, yPos + 1, iBlack, TFT_BLACK);
      Display.drawPixel(xPos + i, yPos + 15, TFT_DARKGREY);
      Display.drawPixel(xPos + i, yPos + 30, TFT_DARKGREY);
      Display.drawPixel(xPos + i, yPos + 45, TFT_DARKGREY);
      Display.drawPixel(xPos + i, yPos + 60, TFT_DARKGREY);
    } 
  }
}

void DrawWifi(int xPos, int yPos, uint16_t u16Color, String sDbValue)
{
  // 'WiFi', 31x22px
  const uint8_t bitmap[] = {
    0x00, 0x00, 0x00, 0x00, 0x00, 0x1f, 0xf0, 0x00, 0x00, 0xff, 0xfe, 0x00, 0x01, 0xff, 0xff, 0x80, 
    0x07, 0xe0, 0x0f, 0xc0, 0x0f, 0x00, 0x01, 0xe0, 0x1e, 0x00, 0x00, 0xf0, 0x3c, 0x07, 0xc0, 0x78, 
    0x78, 0x1f, 0xf0, 0x3c, 0x70, 0x7e, 0xfc, 0x1c, 0x20, 0xf0, 0x1e, 0x08, 0x01, 0xe0, 0x0f, 0x00, 
    0x03, 0xc0, 0x07, 0x80, 0x03, 0x80, 0x03, 0x80, 0x01, 0x03, 0x81, 0x00, 0x00, 0x07, 0xc0, 0x00, 
    0x00, 0x0f, 0xe0, 0x00, 0x00, 0x0f, 0xe0, 0x00, 0x00, 0x0f, 0xe0, 0x00, 0x00, 0x07, 0xc0, 0x00, 
    0x00, 0x03, 0x80, 0x00, 0x00, 0x00, 0x00, 0x00
  };
  Display.drawBitmap(xPos, yPos, bitmap, 31, 22, u16Color);
  if(sDbValue.length() > 0){
    Display.setTextColor(TFT_WHITE, TFT_BLACK);
    Display.setTextSize(1);
    Display.setCursor(xPos + 25, yPos + 22);
    Display.print(sDbValue + "dBm");
  }
  else{
    Display.fillRect(xPos + 24, yPos + 21, 43, 10, TFT_BLACK);
  }
}

void DrawCloud(int xPos, int yPos, uint16_t u16Color)
{
  // 'Cloud', 32x20px
  const uint8_t bitmap[] = {
    0x00, 0x00, 0x00, 0x00, 0x00, 0x07, 0xc0, 0x00, 0x00, 0x1e, 0x78, 0x00, 0x00, 0x30, 0x1c, 0x00, 
    0x00, 0x60, 0x0e, 0x00, 0x00, 0xc0, 0x06, 0x00, 0x00, 0xc0, 0x07, 0xe0, 0x01, 0x80, 0x0e, 0x78, 
    0x0f, 0xc0, 0x18, 0x1c, 0x1c, 0x00, 0x10, 0x0c, 0x30, 0x00, 0x00, 0x06, 0x20, 0x00, 0x00, 0x06, 
    0x60, 0x00, 0x00, 0x02, 0x60, 0x00, 0x00, 0x06, 0x60, 0x00, 0x00, 0x0e, 0x30, 0x00, 0x00, 0x0c, 
    0x38, 0x00, 0x00, 0x18, 0x1f, 0xff, 0xff, 0xf0, 0x07, 0xff, 0xff, 0xe0, 0x00, 0x00, 0x00, 0x00
  };
  Display.drawBitmap(xPos, yPos, bitmap, 32, 20, u16Color);
}

void DrawComputer(int xPos, int yPos, uint16_t u16Color)
{
  // 'Computer', 32x25px
  const uint8_t bitmap[] = {
    0x00, 0x00, 0x00, 0x00, 0x3f, 0xff, 0xff, 0xfc, 0x7f, 0xff, 0xff, 0xfe, 0x60, 0x00, 0x00, 0x06, 
    0x60, 0x00, 0x00, 0x06, 0x60, 0x00, 0x00, 0x06, 0x60, 0x38, 0x08, 0x06, 0x60, 0x7c, 0x0c, 0x06, 
    0x60, 0xc4, 0xc4, 0x06, 0x60, 0xc0, 0xc6, 0x06, 0x60, 0xc0, 0x02, 0x06, 0x60, 0xc0, 0x03, 0x06, 
    0x60, 0xc4, 0xc1, 0x06, 0x60, 0x7c, 0xc1, 0x86, 0x60, 0x38, 0x00, 0x86, 0x60, 0x00, 0x00, 0x06, 
    0x60, 0x00, 0x00, 0x06, 0x60, 0x00, 0x00, 0x06, 0x7f, 0xff, 0xff, 0xfe, 0x3f, 0xff, 0xff, 0xfc, 
    0x00, 0x00, 0x00, 0x00, 0x00, 0x3f, 0xfc, 0x00, 0x00, 0x7f, 0xfe, 0x00, 0x00, 0x7f, 0xfe, 0x00, 
    0x00, 0x00, 0x00, 0x00
  };
  Display.drawBitmap(xPos, yPos, bitmap, 32, 25, u16Color);
}

void DrawArrowUp(int xPos, int yPos, uint16_t u16Color)
{
  // 'DrawArrowUp', 20x26px
  const uint8_t bitmap[] = {
    0x00, 0x00, 0x00, 0x00, 0x60, 0x00, 0x00, 0xf0, 0x00, 0x01, 0xf8, 0x00, 0x03, 0xfc, 0x00, 0x07, 
    0xfe, 0x00, 0x0f, 0xff, 0x00, 0x1f, 0xff, 0x80, 0x3f, 0xff, 0xc0, 0x3f, 0xff, 0xc0, 0x01, 0xf8, 
    0x00, 0x01, 0xf8, 0x00, 0x01, 0xf8, 0x00, 0x01, 0xf8, 0x00, 0x01, 0xf8, 0x00, 0x01, 0xf8, 0x00, 
    0x01, 0xf8, 0x00, 0x01, 0xf8, 0x00, 0x01, 0xf8, 0x00, 0x01, 0xf8, 0x00, 0x01, 0xf8, 0x00, 0x01, 
    0xf8, 0x00, 0x01, 0xf8, 0x00, 0x01, 0xf8, 0x00, 0x01, 0xf8, 0x00, 0x00, 0x00, 0x00
  };
  Display.drawBitmap(xPos, yPos, bitmap, 20, 26, u16Color);
}


void DrawArrowUpTiny(int xPos, int yPos, uint16_t u16Color)
{
  // 'DrawArrowUp', 12x18px
  const uint8_t bitmap[] = {
    0x00, 0x00, 0x06, 0x00, 0x0f, 0x00, 0x1f, 0x80, 0x3f, 0xc0, 0x7f, 0xe0, 0x7f, 0xe0, 0x0f, 0x00, 
    0x0f, 0x00, 0x0f, 0x00, 0x0f, 0x00, 0x0f, 0x00, 0x0f, 0x00, 0x0f, 0x00, 0x0f, 0x00, 0x0f, 0x00, 
    0x0f, 0x00, 0x00, 0x00
  };
  Display.drawBitmap(xPos, yPos, bitmap, 12, 18, u16Color);
}


void DrawArrowDown(int xPos, int yPos, uint16_t u16Color)
{
  // 'DrawArrowDown', 20x26px
  const uint8_t bitmap[] = {
    0x00, 0x00, 0x00, 0x01, 0xf8, 0x00, 0x01, 0xf8, 0x00, 0x01, 0xf8, 0x00, 0x01, 0xf8, 0x00, 0x01, 
    0xf8, 0x00, 0x01, 0xf8, 0x00, 0x01, 0xf8, 0x00, 0x01, 0xf8, 0x00, 0x01, 0xf8, 0x00, 0x01, 0xf8, 
    0x00, 0x01, 0xf8, 0x00, 0x01, 0xf8, 0x00, 0x01, 0xf8, 0x00, 0x01, 0xf8, 0x00, 0x01, 0xf8, 0x00, 
    0x3f, 0xff, 0xc0, 0x3f, 0xff, 0xc0, 0x1f, 0xff, 0x80, 0x0f, 0xff, 0x00, 0x07, 0xfe, 0x00, 0x03, 
    0xfc, 0x00, 0x01, 0xf8, 0x00, 0x00, 0xf0, 0x00, 0x00, 0x60, 0x00, 0x00, 0x00, 0x00
  };
  Display.drawBitmap(xPos, yPos, bitmap, 20, 26, u16Color);
}


void DrawArrowDownTiny(int xPos, int yPos, uint16_t u16Color)
{
  // 'DrawArrowDown', 12x18px
  const uint8_t bitmap[] = {
    0x00, 0x00, 0x0f, 0x00, 0x0f, 0x00, 0x0f, 0x00, 0x0f, 0x00, 0x0f, 0x00, 0x0f, 0x00, 0x0f, 0x00, 
    0x0f, 0x00, 0x0f, 0x00, 0x0f, 0x00, 0x7f, 0xe0, 0x7f, 0xe0, 0x3f, 0xc0, 0x1f, 0x80, 0x0f, 0x00, 
    0x06, 0x00, 0x00, 0x00
  };
  Display.drawBitmap(xPos, yPos, bitmap, 12, 18, u16Color);
}


void DrawRouter(int xPos, int yPos, boolean blnActive)
{
  // 'Router White', 42x32px
  const uint8_t bitmap_01[] = {
    0x00, 0x00, 0x04, 0x00, 0x04, 0x00, 0x00, 0x00, 0x0c, 0x00, 0x06, 0x00, 0x00, 0x00, 0x0d, 0x80, 
    0x36, 0x00, 0x00, 0x00, 0x19, 0x00, 0x13, 0x00, 0x00, 0x00, 0x1b, 0x60, 0xdb, 0x00, 0x00, 0x00, 
    0x1b, 0x60, 0xdb, 0x00, 0x00, 0x00, 0x12, 0x40, 0x49, 0x00, 0x00, 0x00, 0x12, 0x40, 0x49, 0x00, 
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    0x00, 0x00, 0x00, 0x00, 0x00, 0x00, 0x00, 0x00, 0x00, 0x00, 0x00, 0x00, 0x00, 0x00, 0x00, 0x00
  };
  Display.drawBitmap(xPos, yPos, bitmap_01, 42, 32, TFT_WHITE);
  
  // 'Router Antenna', 42x32px
  const uint8_t bitmap_02[] = {
    0x00, 0x00, 0x00, 0x00, 0x00, 0x00, 0x00, 0x00, 0x00, 0x00, 0x00, 0x00, 0x00, 0x00, 0x00, 0x00, 
    0x00, 0x00, 0x00, 0x00, 0x00, 0x00, 0x00, 0x00, 0x00, 0x00, 0x00, 0x00, 0x00, 0x00, 0x00, 0x00, 
    0x00, 0x00, 0x00, 0x00, 0x00, 0x00, 0x00, 0x00, 0x00, 0x00, 0x00, 0x00, 0x00, 0x04, 0x00, 0x00, 
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    0x00, 0x00, 0x00, 0x00, 0x00, 0x00, 0x00, 0x00, 0x00, 0x00, 0x00, 0x00, 0x00, 0x00, 0x00, 0x00
  };
  if (blnActive == true) Display.drawBitmap(xPos, yPos, bitmap_02, 42, 32, TFT_LIGHTGREY);
  else Display.drawBitmap(xPos, yPos, bitmap_02, 42, 32, TFT_DARKGREY);

  // 'Router Body', 42x32px
  const uint8_t bitmap_03[] = {
    0x00, 0x00, 0x00, 0x00, 0x00, 0x00, 0x00, 0x00, 0x00, 0x00, 0x00, 0x00, 0x00, 0x00, 0x00, 0x00, 
    0x00, 0x00, 0x00, 0x00, 0x00, 0x00, 0x00, 0x00, 0x00, 0x00, 0x00, 0x00, 0x00, 0x00, 0x00, 0x00, 
    0x00, 0x00, 0x00, 0x00, 0x00, 0x00, 0x00, 0x00, 0x00, 0x00, 0x00, 0x00, 0x00, 0x00, 0x00, 0x00, 
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    0xff, 0xff, 0xf0, 0x00, 0x03, 0xff, 0xff, 0xff, 0xc0, 0x00, 0x00, 0x00, 0x00, 0x00, 0x00, 0x00
  };
  if (blnActive == true) Display.drawBitmap(xPos, yPos, bitmap_03, 42, 32, 0xB000);
  else Display.drawBitmap(xPos, yPos, bitmap_03, 42, 32, 0x3186);
  
  // 'Router Antenna Shape', 42x32px
  const uint8_t bitmap_04[] = {
    0x00, 0x00, 0x00, 0x00, 0x00, 0x00, 0x00, 0x00, 0x00, 0x00, 0x00, 0x00, 0x00, 0x00, 0x00, 0x00, 
    0x00, 0x00, 0x00, 0x00, 0x00, 0x00, 0x00, 0x00, 0x00, 0x00, 0x00, 0x00, 0x00, 0x00, 0x00, 0x00, 
    0x00, 0x04, 0x00, 0x00, 0x00, 0x00, 0x00, 0x0e, 0x00, 0x00, 0x00, 0x00, 0x00, 0x0a, 0x00, 0x00, 
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    0x00, 0x00, 0x00, 0x00, 0x00, 0x00, 0x00, 0x00, 0x00, 0x00, 0x00, 0x00, 0x00, 0x00, 0x00, 0x00
  };
  if (blnActive == true) Display.drawBitmap(xPos, yPos, bitmap_04, 42, 32, TFT_BLUE);
  else Display.drawBitmap(xPos, yPos, bitmap_04, 42, 32, TFT_DARKGREY);
  
  // 'Router Shape', 42x32px
  const uint8_t bitmap_05[] = {
    0x00, 0x00, 0x00, 0x00, 0x00, 0x00, 0x00, 0x00, 0x00, 0x00, 0x00, 0x00, 0x00, 0x00, 0x00, 0x00, 
    0x00, 0x00, 0x00, 0x00, 0x00, 0x00, 0x00, 0x00, 0x00, 0x00, 0x00, 0x00, 0x00, 0x00, 0x00, 0x00, 
    0x00, 0x00, 0x00, 0x00, 0x00, 0x00, 0x00, 0x00, 0x00, 0x00, 0x00, 0x00, 0x00, 0x00, 0x00, 0x00, 
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    0x00, 0x00, 0x0c, 0x00, 0x1c, 0x00, 0x00, 0x00, 0x38, 0x00, 0x07, 0xff, 0xff, 0xff, 0xe0, 0x00
  };
  if (blnActive == true) Display.drawBitmap(xPos, yPos, bitmap_05, 42, 32, TFT_RED);
  else Display.drawBitmap(xPos, yPos, bitmap_05, 42, 32, TFT_LIGHTGREY);
  
  // 'Router Green LEDs', 42x32px
  const uint8_t bitmap_06[] = {
    0x00, 0x00, 0x00, 0x00, 0x00, 0x00, 0x00, 0x00, 0x00, 0x00, 0x00, 0x00, 0x00, 0x00, 0x00, 0x00, 
    0x00, 0x00, 0x00, 0x00, 0x00, 0x00, 0x00, 0x00, 0x00, 0x00, 0x00, 0x00, 0x00, 0x00, 0x00, 0x00, 
    0x00, 0x00, 0x00, 0x00, 0x00, 0x00, 0x00, 0x00, 0x00, 0x00, 0x00, 0x00, 0x00, 0x00, 0x00, 0x00, 
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    0x00, 0x00, 0x00, 0x00, 0x00, 0x00, 0x00, 0x00, 0x00, 0x00, 0x00, 0x00, 0x00, 0x00, 0x00, 0x00
  };
  if (blnActive == true) Display.drawBitmap(xPos, yPos, bitmap_06, 42, 32, TFT_DARKGREEN);
  else Display.drawBitmap(xPos, yPos, bitmap_06, 42, 32, TFT_LIGHTGREY);
}


void DrawEarth(int xPos, int yPos, boolean blnActive)
{
  // 'Earth', 40x40px
  const uint8_t bitmap_01[] = {
    0x00, 0x00, 0x00, 0x00, 0x00, 0x00, 0x01, 0xff, 0x80, 0x00, 0x00, 0x0f, 0xc0, 0x70, 0x00, 0x00, 
    0x3f, 0x1f, 0xfc, 0x00, 0x00, 0x60, 0x37, 0xff, 0x00, 0x00, 0xc1, 0x07, 0xff, 0x80, 0x03, 0x80, 
    0xff, 0xff, 0xc0, 0x02, 0x01, 0xff, 0xff, 0xe0, 0x04, 0x03, 0xaf, 0xff, 0xf0, 0x08, 0x06, 0x1b, 
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    0xff, 0xe0, 0x00, 0x00, 0x00, 0x7f, 0x00, 0x00
  };
  if (blnActive == true) Display.drawBitmap(xPos, yPos, bitmap_01, 40, 40, TFT_GREEN);
  else Display.drawBitmap(xPos, yPos, bitmap_01, 40, 40, TFT_LIGHTGREY);

  // 'EarthWater', 40x40px
  const uint8_t bitmap_02[] = {
    0x00, 0x00, 0x00, 0x00, 0x00, 0x00, 0x00, 0x00, 0x00, 0x00, 0x00, 0x00, 0x3f, 0x80, 0x00, 0x00, 
    0x00, 0xe0, 0x00, 0x00, 0x00, 0x1f, 0xc8, 0x00, 0x00, 0x00, 0x3e, 0xf8, 0x00, 0x00, 0x00, 0x7f, 
    0x00, 0x00, 0x00, 0x01, 0xfe, 0x00, 0x00, 0x00, 0x03, 0xfc, 0x50, 0x00, 0x00, 0x07, 0xf9, 0xe4, 
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    0x00, 0x00, 0x00, 0x00, 0x00, 0x00, 0x00, 0x00
  };
  if (blnActive == true) Display.drawBitmap(xPos, yPos, bitmap_02, 40, 40, TFT_BLUE);
  else Display.drawBitmap(xPos, yPos, bitmap_02, 40, 40, 0x3186);
}

void DrawFlash(int xPos, int yPos, uint16_t u16Color)
{
  // 'DrawFlash', 20x34px
  const uint8_t bitmap[] = {
    0x00, 0xfe, 0x00, 0x00, 0xfe, 0x00, 0x01, 0xfc, 0x00, 0x01, 0xfc, 0x00, 0x03, 0xf8, 0x00, 0x03, 
    0xf8, 0x00, 0x07, 0xf0, 0x00, 0x07, 0xf0, 0x00, 0x0f, 0xe0, 0x00, 0x0f, 0xe0, 0x00, 0x1f, 0xff, 
    0xc0, 0x1f, 0xff, 0xc0, 0x3f, 0xff, 0x80, 0x3f, 0xff, 0x80, 0x00, 0x7f, 0x00, 0x00, 0x7f, 0x00, 
    0x00, 0x7e, 0x00, 0x00, 0xfe, 0x00, 0x00, 0xfc, 0x00, 0x00, 0xfc, 0x00, 0x01, 0xf8, 0x00, 0x01, 
    0xf8, 0x00, 0x3f, 0xff, 0xc0, 0x3f, 0xff, 0x80, 0x3f, 0xff, 0x00, 0x1f, 0xfe, 0x00, 0x1f, 0xfc, 
    0x00, 0x1f, 0xf8, 0x00, 0x0f, 0xf0, 0x00, 0x0f, 0xe0, 0x00, 0x0f, 0xc0, 0x00, 0x07, 0x80, 0x00, 
    0x07, 0x00, 0x00, 0x06, 0x00, 0x00
  };
  Display.drawBitmap(xPos, yPos, bitmap, 20, 34, u16Color);
}


void DrawFlashTiny(int xPos, int yPos, uint16_t u16Color)
{
  // 'DrawFlash Tiny', 14x24px
  const uint8_t bitmap[] = {
    0x07, 0xc0, 0x07, 0x80, 0x0f, 0x80, 0x0f, 0x00, 0x1f, 0x00, 0x1e, 0x00, 0x3f, 0xf8, 0x3f, 0xf0, 
    0x7f, 0xf0, 0x01, 0xe0, 0x01, 0xe0, 0x03, 0xc0, 0x03, 0xc0, 0x03, 0x80, 0x07, 0x80, 0x7f, 0xf8, 
    0x7f, 0xf0, 0x3f, 0xe0, 0x3f, 0xc0, 0x3f, 0x80, 0x1f, 0x00, 0x1e, 0x00, 0x1c, 0x00, 0x08, 0x00
  };
  Display.drawBitmap(xPos, yPos, bitmap, 14, 24, u16Color);
}


void DrawFlash02(int xPos, int yPos, uint16_t u16Color)
{
  // 'DrawFlash 02', 32x32px
  const uint8_t bitmap[] = {
    0x00, 0x00, 0x08, 0x00, 0x00, 0x00, 0x18, 0x00, 0x00, 0x00, 0x38, 0x00, 0x00, 0x00, 0x70, 0x00, 
    0x00, 0x00, 0xf0, 0x00, 0x00, 0x01, 0xf0, 0x00, 0x00, 0x03, 0xe0, 0x00, 0x00, 0x07, 0xe0, 0x00, 
    0x00, 0x0f, 0xe0, 0x00, 0x00, 0x1f, 0xc0, 0x00, 0x00, 0x3f, 0xc0, 0x00, 0x00, 0x7f, 0xc0, 0x00, 
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    0x00, 0x0e, 0x00, 0x00, 0x00, 0x1c, 0x00, 0x00, 0x00, 0x18, 0x00, 0x00, 0x00, 0x10, 0x00, 0x00
  };
  Display.drawBitmap(xPos, yPos, bitmap, 32, 32, u16Color);
}

void DrawGuest(int xPos, int yPos, uint16_t u16ColorF, uint16_t u16ColorB)
{
  // 'Gast vorne', 26x24px
  const uint8_t bitmap_front[] = {
    0x00, 0x00, 0x00, 0x00, 0x00, 0x00, 0x00, 0x00, 0x00, 0x00, 0x00, 0x00, 0x00, 0x00, 0x00, 0x00, 
    0x00, 0x00, 0x00, 0x00, 0x00, 0x00, 0x00, 0x00, 0x00, 0x00, 0xf8, 0x00, 0x00, 0x01, 0xfc, 0x00, 
    0x00, 0x01, 0xfc, 0x00, 0x00, 0x03, 0xfe, 0x00, 0x00, 0x03, 0xfe, 0x00, 0x00, 0x03, 0xfe, 0x00, 
    0x00, 0x01, 0xfc, 0x00, 0x00, 0x01, 0xfc, 0x00, 0x00, 0x00, 0xf8, 0x00, 0x00, 0x03, 0xfe, 0x00, 
    0x00, 0x03, 0xfe, 0x00, 0x00, 0x07, 0xff, 0x00, 0x00, 0x07, 0xff, 0x00, 0x00, 0x07, 0xff, 0x00, 
    0x00, 0x0f, 0xff, 0x80, 0x00, 0x0f, 0xff, 0x80, 0x00, 0x0f, 0xff, 0x80, 0x00, 0x00, 0x00, 0x00
  };
  Display.drawBitmap(xPos, yPos, bitmap_front, 26, 24, u16ColorF);

  // 'Gast hinten', 26x24px
  const uint8_t bitmap_back[] = {
    0x00, 0xe0, 0x00, 0x00, 0x03, 0xf8, 0x00, 0x00, 0x07, 0xfc, 0x00, 0x00, 0x0f, 0xfe, 0x00, 0x00, 
    0x0f, 0xfe, 0x00, 0x00, 0x1f, 0xfe, 0x00, 0x00, 0x1f, 0xfe, 0x00, 0x00, 0x1f, 0xfc, 0x00, 0x00, 
    0x0f, 0xf8, 0x00, 0x00, 0x0f, 0xf8, 0x00, 0x00, 0x07, 0xf8, 0x00, 0x00, 0x03, 0xf8, 0x00, 0x00, 
    0x07, 0xf8, 0x00, 0x00, 0x0f, 0xfc, 0x00, 0x00, 0x1f, 0xfc, 0x00, 0x00, 0x1f, 0xf8, 0x00, 0x00, 
    0x3f, 0xf8, 0x00, 0x00, 0x3f, 0xf0, 0x00, 0x00, 0x3f, 0xf0, 0x00, 0x00, 0x7f, 0xf0, 0x00, 0x00, 
    0x7f, 0xe0, 0x00, 0x00, 0x7f, 0xe0, 0x00, 0x00, 0x7f, 0xe0, 0x00, 0x00, 0x00, 0x00, 0x00, 0x00
  };
  Display.drawBitmap(xPos, yPos, bitmap_back, 26, 24, u16ColorB);

  Display.setTextColor(u16ColorF, TFT_BLACK);
  Display.setTextSize(1);
  Display.setCursor(xPos + 24, yPos + 1);
  Display.print("Gast");
}

void DrawLogo(int xPos, int yPos)
{
  Display.fillRoundRect(xPos, yPos, 120, 87, 10, TFT_YELLOW);
  Display.drawRoundRect(xPos, yPos, 120, 87, 10, TFT_DARKCYAN);
  Display.drawRoundRect(xPos+1, yPos+1, 118, 85, 10, TFT_BLUE);
  Display.drawRoundRect(xPos+2, yPos+2, 116, 83, 9, TFT_BLUE);
    
  // 'DrawLogo Tiny Black', 100x67px
  const uint8_t bitmapBlack[] = {
    0x00, 0x00, 0x00, 0x00, 0x00, 0x00, 0x00, 0x00, 0x00, 0x00, 0x00, 0x00, 0x00, 0x00, 0x00, 0x00, 
    0x00, 0x00, 0x00, 0x00, 0x00, 0x00, 0x00, 0x00, 0x00, 0x00, 0x00, 0x00, 0x00, 0x00, 0x00, 0x00, 
    0x00, 0x00, 0x00, 0x00, 0x00, 0x00, 0x00, 0x00, 0x00, 0x00, 0x00, 0x00, 0x00, 0x00, 0x00, 0x00, 
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    0x00, 0x00, 0x00, 0x00, 0x00, 0x00, 0x00
  };
  Display.drawBitmap(xPos + 10, yPos + 10, bitmapBlack, 100, 67, TFT_BLACK);
  
 // 'DrawLogo Tiny Red', 100x67px
  const uint8_t bitmapRed[] = {
    0x00, 0x00, 0x00, 0x00, 0x00, 0x00, 0x00, 0x00, 0x00, 0x00, 0x00, 0x00, 0x00, 0x00, 0x00, 0x00, 
    0x00, 0x00, 0x00, 0x00, 0x00, 0x00, 0x00, 0x00, 0x00, 0x00, 0x00, 0x00, 0x00, 0x00, 0x00, 0x00, 
    0x00, 0x00, 0x00, 0x00, 0x00, 0x00, 0x00, 0x00, 0x00, 0x00, 0x00, 0x00, 0x00, 0x00, 0x00, 0x00, 
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    0x00, 0x00, 0x00, 0x00, 0x00, 0x00, 0x00
  };
  Display.drawBitmap(xPos + 10, yPos + 10, bitmapRed, 100, 67, 0xB000);
  
 // 'DrawLogo Tiny Blue', 100x67px
  const uint8_t bitmapBlue[] = {
    0x00, 0x00, 0x00, 0x00, 0x00, 0x00, 0x00, 0x00, 0x00, 0x00, 0x00, 0x00, 0x00, 0x00, 0x00, 0x00, 
    0x00, 0x00, 0x00, 0x00, 0x00, 0x00, 0x00, 0x00, 0x00, 0x00, 0x00, 0x00, 0x00, 0x00, 0x00, 0x00, 
    0x00, 0x00, 0x00, 0x00, 0x00, 0x00, 0x00, 0x00, 0x00, 0x00, 0x00, 0x00, 0x00, 0x00, 0x00, 0x00, 
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    0x00, 0x00, 0x00, 0x00, 0x00, 0x00, 0x00
  };
  Display.drawBitmap(xPos + 10, yPos + 10, bitmapBlue, 100, 67, TFT_BLUE);
}

void DrawMessageScreen_01(String sIP_Address)
{
  int iPosX = 10;
  int iPosY = 20;

  Display.fillScreen(TFT_BLACK);
  DrawLogo(190,10);
  Display.setTextSize(1);
  Display.setTextColor(TFT_WHITE);
  Display.setCursor(iPosX, iPosY);
  Display.println("Der WebMonitor ist noch nicht");
  Serial.println("Der WebMonitor ist noch nicht");
  iPosY = iPosY + 15; Display.setCursor(iPosX, iPosY);
  Display.println("konfiguriert. Zur");
  Serial.println("konfiguriert. Zur");
  iPosY = iPosY + 15; Display.setCursor(iPosX, iPosY);
  Display.println("Konfiguration einen Computer");
  Serial.println("Konfiguration einen Computer");
  iPosY = iPosY + 15; Display.setCursor(iPosX, iPosY);
  Display.println("mit dem WLAN \"WebMonitor\"");
  Serial.println("mit dem WLAN \"WebMonitor\"");
  iPosY = iPosY + 15; Display.setCursor(iPosX, iPosY);
  Display.println("verbinden und die Website");
  Serial.println("verbinden und die Website");
  iPosY = iPosY + 15; Display.setCursor(iPosX, iPosY);
  Display.println("http://" + sIP_Address + "/index.html");
  Serial.println("http://" + sIP_Address + "/index.html");
  iPosY = iPosY + 15; Display.setCursor(iPosX, iPosY);
  Display.println("mit einem Browser \224ffnen.");
  Serial.println("mit einem Browser \224ffnen.");
  iPosY = iPosY + 15; Display.setCursor(iPosX, iPosY);
  Display.println("Die Konfigurationswerte eintragen und auf den");
  Serial.println("Die Konfigurationswerte eintragen und auf den");
  iPosY = iPosY + 15; Display.setCursor(iPosX, iPosY);
  Display.println("Button \"Alle Werte \201bernehmen\" klicken.");
  Serial.println("Button \"Alle Werte \201bernehmen\" klicken.");
  iPosY = iPosY + 15; Display.setCursor(iPosX, iPosY);
  Display.println("Danach den WebMonitor neu starten.");
  Serial.println("Danach den  WebMonitor neu starten.");
  iPosY = iPosY = iPosY + 30; Display.setCursor(iPosX, iPosY);
  Display.setTextColor(TFT_YELLOW);
  Display.println("ACHTUNG: Unbedingt auch die auf der Website");
  Serial.println("ACHTUNG: Unbedingt auch die auf der Website");
  iPosY = iPosY + 15; Display.setCursor(iPosX, iPosY);
 Display.println("beschriebenen Einstellungen f\201r die TR-064");
  Serial.println("beschriebenen Einstellungen f\201r die TR-064");
  iPosY = iPosY + 15; Display.setCursor(iPosX, iPosY);
  Display.println("Kommunikation mit dem Router vornehmen.");
  Serial.println("Kommunikation mit dem Router vornehmen.");
}

void DrawMessageScreen_02(String sWifiSSID, String sWifiPassword, String sTR064_User, String sTR064_Password, String sMaxDL_Speed, String sMaxUL_Speed)
{
  int iPosX = 10;
  int iPosY = 20;

  Display.fillScreen(TFT_BLACK);
  DrawLogo(190,10);
  Display.setTextSize(1);
  Display.setTextColor(TFT_WHITE);
  Display.setCursor(iPosX, iPosY);
  Display.println("WLAN Name:");
  Serial.println("WLAN Name:");
  iPosY = iPosY + 15; Display.setCursor(iPosX, iPosY);
  Display.println("   \"" + sWifiSSID + "\"");
  Serial.println("   \"" + sWifiSSID + "\"");
  iPosY = iPosY + 20;Display.setCursor(iPosX, iPosY);
  Display.println("WLAN Passwort:");
  Serial.println("WLAN Passwort:");
  iPosY = iPosY + 15; Display.setCursor(iPosX, iPosY);
  Display.println("   \"" + sWifiPassword + "\"");
  Serial.println("   \"" + sWifiPassword + "\"");
  iPosY = iPosY + 20; Display.setCursor(iPosX, iPosY);
  Display.println("TR-064 User:");
  Serial.println("TR-064 User:");
  iPosY = iPosY + 15; Display.setCursor(iPosX, iPosY);
  Display.println("   \"" + sTR064_User + "\"");
  Serial.println("   \"" + sTR064_User + "\"");
  iPosY = iPosY + 20; Display.setCursor(iPosX, iPosY);
  Display.println("TR-064 Passwort:");
  Serial.println("TR-064 Passwort:");
  iPosY = iPosY + 15; Display.setCursor(iPosX, iPosY);
  Display.println("   \"" + sTR064_Password + "\"");
  Serial.println("   \"" + sTR064_Password + "\"");
  iPosY = iPosY + 20; Display.setCursor(iPosX, iPosY);
  Display.println("Download Speed - Upload Speed:");    
  Serial.println("Download Speed - Upload Speed:");    
  iPosY = iPosY + 15; Display.setCursor(iPosX, iPosY);      
  Display.print("   " + sMaxDL_Speed + " MBit/s - ");      
  Serial.print("   " + sMaxDL_Speed + " MBit/s - ");      
  Display.println(sMaxUL_Speed + " MBit/s");    
  Serial.println(sMaxUL_Speed + " MBit/s");    
  Display.setTextColor(TFT_CYAN);
  iPosY = iPosY + 20; Display.setCursor(iPosX, iPosY);
  Display.println("Jetzt den WebMonitor neu starten.");
  Serial.println("Jetzt den WebMonitor neu starten.");
  iPosY = iPosY + 15; Display.setCursor(iPosX, iPosY);
  Display.println("Dazu einen Taster dr\201cken oder die Spannungs-");
  Serial.println("Dazu einen Taster dr\201cken oder die Spannungs-");
  iPosY = iPosY + 15; Display.setCursor(iPosX, iPosY);
  Display.println("versorgung kurz trennen und wieder verbinden.");
  Serial.println("versorgung kurz trennen und wieder verbinden.");
}

void DrawMessageScreen_03(void)
{
  int iPosX = 10;
  int iPosY = 110;

  Display.fillScreen(TFT_BLACK);
  DrawLogo(190,0);
  Display.setTextSize(2);
  Display.setTextColor(TFT_WHITE);
  Display.setCursor(iPosX, iPosY);
  Display.println("Die Taste ca. 8 Sekunden");
  Serial.println("Die Taste ca. 8 Sekunden");
  iPosY = iPosY + 25; Display.setCursor(iPosX, iPosY);
  Display.println("gedr\201ckt halten, um");
  Serial.println("gedr\201ckt halten, um");
  iPosY = iPosY + 25; Display.setCursor(iPosX, iPosY);
  Display.println("die existierende");
  Serial.println("die existierende");
  iPosY = iPosY + 25; Display.setCursor(iPosX, iPosY);
  Display.println("Konfiguration zu l\224schen.");
  Serial.println("Konfiguration zu l\224schen.");
}

void DrawMessageScreen_04(void)
{
  int iPosX = 10;
  int iPosY = 100;

  Display.fillScreen(TFT_BLACK);
  DrawLogo(190,0);
  Display.setTextSize(2);
  Display.setTextColor(TFT_RED);
  Display.setCursor(iPosX, iPosY);
  Display.println("Die Konfiguration wurde");
  Serial.println("Die Konfiguration wurde");
  iPosY = iPosY + 25; Display.setCursor(iPosX, iPosY);
  Display.println("vollst\204ndig gel\224scht!");
  Serial.println("vollst\204ndig gel\224scht!");
  Display.setTextColor(TFT_WHITE);
  iPosY = iPosY + 50; Display.setCursor(iPosX, iPosY);
  Display.println("In wenigen Sekunden wird");
  Serial.println("In wenigen Sekunden wird");
  iPosY = iPosY + 25; Display.setCursor(iPosX, iPosY);
  Display.println("ein Neustart durchgef\201hrt");
  Serial.println("ein Neustart durchgef\201hrt");
}
